## conf/layer.conf
```bitbake
# We have a conf and classes directory, add to BBPATH
BBPATH .= ":${LAYERDIR}"

# We have recipes-* directories, add to BBFILES
BBFILES += "${LAYERDIR}/recipes-*/*/*.bb \
            ${LAYERDIR}/recipes-*/*/*.bbappend"

BBFILE_COLLECTIONS += "meta-cip-kernel"
BBFILE_PATTERN_meta-cip-kernel = "^${LAYERDIR}/"
BBFILE_PRIORITY_meta-cip-kernel = "61"

LAYERDEPENDS_meta-cip-kernel = "core"
LAYERSERIES_COMPAT_meta-cip-kernel = "kirkstone"
```
